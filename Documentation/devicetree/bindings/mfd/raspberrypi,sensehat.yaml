## Documentation/devicetree/bindings/mfd/raspberrypi,sensehat.yaml
```yaml
# SPDX-License-Identifier: (GPL-2.0 OR BSD-2-Clause)
%YAML 1.2
---

$id: http://devicetree.org/schemas/mfd/raspberrypi,sensehat.yaml#
$schema: http://devicetree.org/meta-schemas/core.yaml#

title: Raspberry Pi Sense HAT

maintainers:
  - Sharvari Mishra <sharmish@qti.qualcomm.com>

description: |
  Raspberry Pi Sense HAT is an I2C-attached multi-function device.
  It can expose a joystick child node on supported platforms.

properties:
  compatible:
    const: raspberrypi,sensehat

  reg:
    maxItems: 1

  status: true

patternProperties:
  "^joystick$":
    type: object
    description: Sense HAT joystick child node

    properties:
      compatible:
        const: raspberrypi,sensehat-joystick

      status: true
      pinctrl-names: true
      pinctrl-0: true
      interrupt-parent: true

      interrupts:
        maxItems: 1

    required:
      - compatible

    additionalProperties: false

required:
  - compatible
  - reg

additionalProperties: false

examples:
  - |
    i2c {
        #address-cells = <1>;
        #size-cells = <0>;

        sensehat@46 {
            compatible = "raspberrypi,sensehat";
            reg = <0x46>;

            joystick {
                compatible = "raspberrypi,sensehat-joystick";
                interrupt-parent = <&gpio>;
                interrupts = <23 1>; /* rising edge */
            };
        };
    };
```

## Documentation/devicetree/bindings/phy/qcom,emu-phy.yaml
```yaml
# SPDX-License-Identifier: (GPL-2.0 OR BSD-2-Clause)

%YAML 1.2
---
$id: http://devicetree.org/schemas/phy/qcom,emu-phy.yaml#
$schema: http://devicetree.org/meta-schemas/core.yaml#

title: Qualcomm Technologies, Inc. emulation USB PHY driver

maintainers:
  - Wesley Cheng <quic_wcheng@quicinc.com>

description:
  Enable this to support the USB transceiver used on
  Qualcomm Technologies, Inc. emulation platforms. It simply performs
  PHY initialization given a basic register write sequence.

properties:
  compatible:
    const: qcom,usb-emu-phy

  reg:
    maxItems: 2

  "#phy-cells":
    const: 0

  qcom,emu-init-seq:
    $ref: /schemas/types.yaml#/definitions/uint8-matrix
    description: >
      Sequence of address and value pairs to
      program the emulated PHY.
    maxItems: 64 # no hard limit
    items:
      items:
        - description: >
            the address is offset from base.
        - description: value to be programmed.

required:
  - compatible
  - reg
  - "#phy-cells"
  - qcom,emu-init-seq

additionalProperties: false

examples:
  - |
    usb_emu_phy_0: usb_emu_phy@a784000 {
        compatible = "qcom,usb-emu-phy";
        reg = <0 0x0a784000 0 0x9500>;
        #phy-cells = <0>;
        qcom,emu-init-seq = <0xfffff 0x4
                             0x2110010 0x34
                             0x0110010 0x34
                             0xffff3 0x4
                             0xffff0 0x4
                             0x100000 0x20
                             0x0 0x20
                             0x1A0 0x20
                             0x100000 0x3c
                             0x0 0x3c
                             0x10060 0x3c
                             0x0 0x4
                             0x9 0x14>;
    };
```

## arch/arm/configs/generic_tele_min_defconfig
```kconfig
CONFIG_ARCH_QCOM=y
# CONFIG_FIPS_SIGNATURE_SELFTEST is not set
CONFIG_MODULE_SIG=y
CONFIG_MODULE_SIG_ALL=y
# CONFIG_MODULE_SIG_FORCE is not set
CONFIG_MODULE_SIG_FORMAT=y
CONFIG_MODULE_SIG_HASH="sha1"
CONFIG_MODULE_SIG_KEY="certs/signing_key.pem"
# CONFIG_MODULE_SIG_KEY_TYPE_ECDSA is not set
CONFIG_MODULE_SIG_KEY_TYPE_RSA=y
# CONFIG_MODULE_SIG_PROTECT is not set
CONFIG_MODULE_SIG_SHA1=y
# CONFIG_MODULE_SIG_SHA224 is not set
# CONFIG_MODULE_SIG_SHA256 is not set
# CONFIG_MODULE_SIG_SHA384 is not set
# CONFIG_MODULE_SIG_SHA512 is not set
CONFIG_PKCS7_MESSAGE_PARSER=y
# CONFIG_PKCS7_TEST_KEY is not set
# CONFIG_SIGNED_PE_FILE_VERIFICATION is not set
CONFIG_SYSTEM_DATA_VERIFICATION=y
CONFIG_SGL_ALLOC=y
```

## drivers/extcon/Kconfig
```kconfig
# SPDX-License-Identifier: GPL-2.0-only
#
# EXTCON drivers
#
# When adding new entries keep the list in alphabetical order

config EXTCON_QTI_SPMI_MISC
	tristate "Qualcomm USB extcon support"
	depends on ARCH_QCOM || COMPILE_TEST
	help
	  Say Y here to enable SPMI PMIC based USB cable detection
	  support on Qualcomm PMICs such as PM8941.

	  This driver provides USB ID and VBUS detection support through
	  the extcon framework. It handles USB host/device role switching
	  by monitoring the USB ID pin and VBUS line states.

	  To compile this driver as a module, choose M here: the
	  module will be called extcon-qti-spmi-misc.
```

## drivers/firmware/qcom/si_core/Kconfig
```kconfig
# SPDX-License-Identifier: GPL-2.0-only

config QCOM_SI_CORE
	tristate "Secure QTEE Communication Support"
	depends on QCOM_SCM
	help
	  Enable SI-CORE driver which supports capability based secure
	  communication between QTEE and VM. Using SI-CORE, kernel can
	  issue	calls to QTEE or TAs to request a service or exposes services
	  to QTEE and TAs. The SI-CORE implements the necessary marshaling of
	  messages with QTEE.

config QCOM_SI_CORE_WQ
	bool "Use direct invocation for RELEASE requests"
	depends on QCOM_SI_CORE
	help
	  Use a kernel thread to issue RELEASE request to QTEE and TAs
	  instead of using asynchronous messages. It may slow down the system
	  and prone to failure as it uses direct invocation which requires
	  extra resources from QTEE.

	  Enable if only QTEE does not support asynchronous message.

config QCOM_SI_CORE_ADCI
	bool "Use ADCI thread to cater service requests from other VMs"
	depends on QCOM_SI_CORE
	help
	  Use a kernel thread to register callback service to QTEE that
	  will cater requests initiated by other VMs requiring services
	  hosted by primary VM.

	  This option should not be enabled on guest virtual machines.
	  The initialization and shutdown of the ADCI thread within the
	  SI Core component are unnecessary in guest VM environments, as
	  the host operating system typically handles ADCI functionality.

	  Enable this option if there are multiple VMs and services are
	  hosted only by primary VM.

	  Disable this option to avoid ADCI thread management in guest VMs.
```

## drivers/iio/imu/stm/Kconfig
```kconfig
# SPDX-License-Identifier: GPL-2.0-only
#
# STM Industrial I/O drivers configuration
#
# When adding new entries keep the list in alphabetical order

menuconfig IIO_STM
           tristate "STM MEMS Device Drivers"

if IIO_STM

source "drivers/iio/imu/stm/accel/Kconfig"
source "drivers/iio/imu/stm/imu/Kconfig"
source "drivers/iio/imu/stm/magnetometer/Kconfig"
source "drivers/iio/imu/stm/pressure/Kconfig"
source "drivers/iio/imu/stm/temperature/Kconfig"

endif # IIO_STM
```

## drivers/platform/msm/Kconfig
```kconfig
# SPDX-License-Identifier: GPL-2.0-only

menu "Qualcomm technologies inc. MSM specific device drivers"
	depends on ARCH_QCOM

config EP_PCIE
	tristate "PCIe Endpoint mode support"
	depends on QCOM_PCI_EDMA
	select GENERIC_ALLOCATOR
	help
	  PCIe controller is in endpoint mode.
	  It supports the APIs to clients as a service layer, and allows
	  clients to enable/disable PCIe link, configure the address
	  mapping for the access to host memory, trigger wake interrupt
	  on host side to wake up host, and trigger MSI to host side.

endmenu
```

## drivers/usb/typec/mux/Kconfig
```kconfig
# SPDX-License-Identifier: GPL-2.0-only
#
# Type-C mux drivers
#

config TYPEC_MUX_PS883X
	tristate "Parade PS883x Type-C retimer driver"
	depends on I2C
	depends on DRM || DRM=n
	select DRM_AUX_BRIDGE if DRM_BRIDGE && OF
	select FW_LOADER
	select REGMAP_I2C
	help
	  Say Y or M if your system has a Parade PS883x Type-C retimer chip
	  found on some devices with a Type-C port. The driver also exposes
	  a sysfs-triggered firmware update path backed by the kernel firmware
	  loader.
```

## drivers/virt/gunyah/Kconfig
```kconfig
# SPDX-License-Identifier: GPL-2.0-only

config GH_VIRT_WATCHDOG
	tristate "Gunyah Virtual Watchdog Driver"
	depends on QCOM_WDT_CORE
	help
	  This enables the Qualcomm Technologies, Inc. watchdog module for
	  the Gunyah hypervisor. It provides an interface to perform watchdog
	  actions such as setting the bark/bite time and also petting the
	  watchdog in the hypervisor.
```

## net/embms_kernel/Kconfig
```kconfig
# SPDX-License-Identifier: GPL-2.0-only
#
# embms tunnuning module
#
config EMBMS_TUNNULING
        bool "eMBMS Tunneling"
        help
          optimized unicast tunneling within kernel of eMBMS traffic.
```
